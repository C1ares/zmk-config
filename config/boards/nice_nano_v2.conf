## config/boards/nice_nano_v2.conf
```kconfig
# Enable underglow
CONFIG_ZMK_RGB_UNDERGLOW=y
# Use the STRIP config specific to the LEDs you're using
CONFIG_WS2812_STRIP=y
# Underglow settings
CONFIG_ZMK_RGB_UNDERGLOW_ON_START=y
CONFIG_ZMK_RGB_UNDERGLOW_EXT_POWER=y
CONFIG_ZMK_RGB_UNDERGLOW_HUE_START=0
CONFIG_ZMK_RGB_UNDERGLOW_SAT_START=100
CONFIG_ZMK_RGB_UNDERGLOW_BRT_START=100
# display
CONFIG_ZMK_DISPLAY=y
CONFIG_DISPLAY=y
# NKRO
CONFIG_ZMK_HID_REPORT_TYPE_NKRO=y
```
